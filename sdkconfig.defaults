## sdkconfig.defaults
```kconfig
#
# ESP TinyUSB Features
#
CONFIG_ENABLE_ESP_TINYUSB_FEATURES=y
CONFIG_USE_SYNOPSYS_DWC2_DRIVER=y

#
# HTTP Server
#
CONFIG_HTTPD_WS_SUPPORT=y
# end of HTTP Server
```
